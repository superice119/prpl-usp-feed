## apps/amxrt/Config.in
```kconfig
config PACKAGE_amxrt
    tristate
    select SAH_SERVICES_AMXRT

if PACKAGE_amxrt

menu "Select amxrt build options"
    depends on PACKAGE_amxrt

config SAH_SERVICES_AMXRT
    bool "Build libamxrt application"
    default y

config SAH_SERVICES_AMXRT_PROCD_INIT_FUNCTIONS
    bool "Adds the procd init functions script in stead of the non-procd init functions script"
    default PACKAGE_procd

endmenu

endif
```

## apps/data-model-mapper/Config.in
```kconfig
config PACKAGE_data-model-mapper
    tristate

if PACKAGE_data-model-mapper

menu "Select data-model-mapper build options"
    depends on PACKAGE_data-model-mapper

config DMM_DATA_MODEL_MAPPER_ORDER
    int "Start up order data-model-mapper plugin"
    default 54

endmenu

endif
```

## apps/obuspa/Config.in
```kconfig
menu "Select obuspa build options"
    depends on PACKAGE_obuspa

config OBUSPA_WEBSOCKET_MTP_SUPPORT
    bool "Whether WebSocket MTP support is enabled in the obuspa"
    # prpl-feed deviation from upstream (which defaults n): this feed exists for
    # WebSocket onboarding to a USP Controller, so WS MTP is enabled by default.
    # Pulls in libwebsockets4-full. Set to n to drop WS (e.g. STOMP/UDS-only builds).
    default y

endmenu
```

## apps/usp-discovery/Config.in
```kconfig
menu "Select usp-discovery build options"
    depends on PACKAGE_usp-discovery

config DMM_USP_DISCOVERY_ORDER
    int "Start up order usp-discovery plugin"
    default 99

config USP_DISCOVERY_SUPPORT_MQTT_MTP
    bool "Whether MQTT MTP is supported for USP Controller discovery"
    default n

config USP_DISCOVERY_SUPPORT_STOMP_MTP
    bool "Whether STOMP MTP is supported for USP Controller discovery"
    default n

endmenu
```

## libs/libamxrt/Config.in
```kconfig
config PACKAGE_libamxrt
    tristate
    select SAH_LIB_AMXRT

if PACKAGE_libamxrt

menu "Select libamxrt build options"
    depends on PACKAGE_libamxrt

config SAH_LIB_AMXRT
    bool "Build libamxrt"
    default y
    select KERNEL_EXT4_FS_SECURITY if USES_EXT4 || PACKAGE_kmod-fs-ext4
    select KERNEL_JFFS2_FS_SECURITY if USES_JFFS2 || USES_JFFS2_NAND
    select KERNEL_UBIFS_FS_SECURITY if USES_UBIFS
    select KERNEL_F2FS_FS_SECURITY if PACKAGE_mkf2fs

config SAH_AMXRT_RWDATAPATH
    string "Persistent storage location"
    default "/etc/config"

config FORCE_RUNNING_AS_ROOT
    bool "INSECURE: This options forces ambiorix components to run as the root user, even if they request to run as a different user"
    default y

config REMOVE_CAPS_ODLS
    bool "INSECURE: This option removes all the capability ODLs (*_caps.odl) from /etc/amx and subdirectories during first boot. This will also force all components to run as root"
    default y

endmenu

endif
```

## mods/mod-amxb-ubus/Config.in
```kconfig
config PACKAGE_mod-amxb-ubus
    tristate
    select SAH_LIB_AMXB_UBUS

if PACKAGE_mod-amxb-ubus

menu "Select mod-amxb-ubus build options"
    depends on PACKAGE_mod-amxb-ubus

config SAH_LIB_AMXB_UBUS
    bool "Build ubus backend for ambiorix"
    default y

config SAH_LIB_AMXB_UBUS_ORDER
    string "Backend load order"
    default "05-"

endmenu

endif
```

## mods/mod-amxb-usp/Config.in
```kconfig
config PACKAGE_mod-amxb-usp
    tristate
    select SAH_MOD_AMXB_USP

if PACKAGE_mod-amxb-usp

menu "Select mod-amxb-usp build options"
    depends on PACKAGE_mod-amxb-usp

config SAH_MOD_AMXB_USP
    bool "Build the USP backend for ambiorix"
    default y

config SAH_MOD_AMXB_USP_INSTALL_DIR
    string "Installation directory for the USP backend"
    default "/usr/bin/mods/usp"

config SAH_MOD_AMXB_USP_REQUIRES_DEVICE_PREFIX
    bool "System wide default value for requires-device-prefix, which can be overwritten at odl level"
    default n

endmenu

endif
```

## plugins/tr181-gatewayinfo/Config.in
```kconfig
config PACKAGE_tr181-gatewayinfo

menu "Select tr181-gatewayinfo build options"
    depends on PACKAGE_tr181-gatewayinfo

config DMM_TR181_GATEWAYINFO_ORDER
    int "Start up order tr181-gatewayinfo plugin"
    default 99
endmenu
```
